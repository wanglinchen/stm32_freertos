## osl/src/freertos/portable/Kconfig
```kconfig
# 自动生成，勿手改。刷新：python3 build/create-project.py update
menu "portable"

config OSL_SRC_FREERTOS_PORTABLE_GCC
	bool "GCC"
	default y
if OSL_SRC_FREERTOS_PORTABLE_GCC
source "osl/src/freertos/portable/GCC/Kconfig"
endif

config OSL_SRC_FREERTOS_PORTABLE_MEMMANG
	bool "MemMang"
	default y
if OSL_SRC_FREERTOS_PORTABLE_MEMMANG
source "osl/src/freertos/portable/MemMang/Kconfig"
endif

endmenu
```

## osl/src/freertos/portable/MemMang/Kconfig
```kconfig
# 自动生成，勿手改。刷新：python3 build/create-project.py update
menu "MemMang"

config OSL_SRC_FREERTOS_PORTABLE_MEMMANG_HEAP_4
	bool "heap_4.c"
	default y

endmenu
```

## proj/project_defconfig
```kconfig
# 自动生成，勿手改。刷新：python3 build/create-project.py update
# 工程信息
CONFIG_PROJECT_NAME=stm32-freertos
CONFIG_CPU_MODEL=STM32F429IGT6
CONFIG_CPU_ARCH=cortex-m4
CONFIG_STM32F429XX=y

# osl
CONFIG_OSL=y
CONFIG_OSL_INC=y
CONFIG_OSL_INC_FREERTOS=y
CONFIG_OSL_INC_FREERTOS_PORTABLE=y
CONFIG_OSL_INC_FREERTOS_PORTABLE_GCC=y
CONFIG_OSL_INC_FREERTOS_PORTABLE_GCC_ARM_CM4F=y
CONFIG_OSL_SRC=y
CONFIG_OSL_SRC_FREERTOS=y
CONFIG_OSL_SRC_FREERTOS_PORTABLE=y
CONFIG_OSL_SRC_FREERTOS_PORTABLE_GCC=y
CONFIG_OSL_SRC_FREERTOS_PORTABLE_GCC_ARM_CM4F=y
CONFIG_OSL_SRC_FREERTOS_PORTABLE_GCC_ARM_CM4F_PORT=y
CONFIG_OSL_SRC_FREERTOS_PORTABLE_MEMMANG=y
CONFIG_OSL_SRC_FREERTOS_PORTABLE_MEMMANG_HEAP_4=y

# apl
CONFIG_APL=y
CONFIG_APL_INC=y
CONFIG_APL_SRC=y
CONFIG_APL_SRC_MAIN=y

# fml
CONFIG_FML=y
CONFIG_FML_INC=y
CONFIG_FML_SRC=y
CONFIG_FML_SRC_FML_BUTTON=y
CONFIG_FML_SRC_FML_LED=y

# bsl
CONFIG_BSL=y
CONFIG_BSL_INC=y
CONFIG_BSL_SRC=y
CONFIG_BSL_SRC_BOARD_BEEP=y
CONFIG_BSL_SRC_BOARD_KEY=y
CONFIG_BSL_SRC_BOARD_LED=y

# hal
CONFIG_HAL=y
CONFIG_HAL_ARCH=y
CONFIG_HAL_ARCH_INC=y
CONFIG_HAL_CHIP=y
CONFIG_HAL_CHIP_REGISTER=y
CONFIG_HAL_CHIP_REGISTER_INC=y
CONFIG_HAL_CHIP_STARTUP=y
CONFIG_HAL_CHIP_STARTUP_INC=y
CONFIG_HAL_CHIP_STARTUP_SRC=y
CONFIG_HAL_CHIP_STARTUP_SRC_STARTUP_STM32F429XX=y
CONFIG_HAL_CHIP_STARTUP_SRC_SYSTEM_STM32F4XX=y
CONFIG_HAL_PERIPH=y
CONFIG_HAL_PERIPH_INC=y
CONFIG_HAL_PERIPH_SRC=y
CONFIG_HAL_PERIPH_SRC_STM32F4XX_HAL=y
CONFIG_HAL_PERIPH_SRC_STM32F4XX_HAL_CORTEX=y
CONFIG_HAL_PERIPH_SRC_STM32F4XX_HAL_FLASH=y
CONFIG_HAL_PERIPH_SRC_STM32F4XX_HAL_FLASH_EX=y
CONFIG_HAL_PERIPH_SRC_STM32F4XX_HAL_GPIO=y
CONFIG_HAL_PERIPH_SRC_STM32F4XX_HAL_PWR=y
CONFIG_HAL_PERIPH_SRC_STM32F4XX_HAL_PWR_EX=y
CONFIG_HAL_PERIPH_SRC_STM32F4XX_HAL_RCC=y
CONFIG_HAL_PERIPH_SRC_STM32F4XX_HAL_RCC_EX=y
# >>> USER_CUSTOM
# HAL 驱动裁剪：只保留 init/clock/gpio/cortex/pwr/flash 六个模块（9 个 .c）。
# 其余驱动在此置 n，同时 hal_conf.h 里对应的 HAL_X_MODULE_ENABLED 已注释 ——
# 两者必须同步，verify 的「HAL 模块开关」会校验开关、头文件 include 块与 .o 三者一致。
# 要用某个外设时，把这里的 =n 去掉、并放开 hal_conf.h 里的开关，再 update。
CONFIG_HAL_PERIPH_SRC_STM32F4XX_HAL_ADC=n
CONFIG_HAL_PERIPH_SRC_STM32F4XX_HAL_ADC_EX=n
CONFIG_HAL_PERIPH_SRC_STM32F4XX_HAL_CAN=n
CONFIG_HAL_PERIPH_SRC_STM32F4XX_HAL_CEC=n
CONFIG_HAL_PERIPH_SRC_STM32F4XX_HAL_CRC=n
CONFIG_HAL_PERIPH_SRC_STM32F4XX_HAL_CRYP=n
CONFIG_HAL_PERIPH_SRC_STM32F4XX_HAL_CRYP_EX=n
CONFIG_HAL_PERIPH_SRC_STM32F4XX_HAL_DAC=n
CONFIG_HAL_PERIPH_SRC_STM32F4XX_HAL_DAC_EX=n
CONFIG_HAL_PERIPH_SRC_STM32F4XX_HAL_DCMI=n
CONFIG_HAL_PERIPH_SRC_STM32F4XX_HAL_DCMI_EX=n
CONFIG_HAL_PERIPH_SRC_STM32F4XX_HAL_DFSDM=n
CONFIG_HAL_PERIPH_SRC_STM32F4XX_HAL_DMA=n
CONFIG_HAL_PERIPH_SRC_STM32F4XX_HAL_DMA2D=n
CONFIG_HAL_PERIPH_SRC_STM32F4XX_HAL_DMA_EX=n
CONFIG_HAL_PERIPH_SRC_STM32F4XX_HAL_DSI=n
CONFIG_HAL_PERIPH_SRC_STM32F4XX_HAL_ETH=n
CONFIG_HAL_PERIPH_SRC_STM32F4XX_HAL_EXTI=n
CONFIG_HAL_PERIPH_SRC_STM32F4XX_HAL_FLASH_RAMFUNC=n
CONFIG_HAL_PERIPH_SRC_STM32F4XX_HAL_FMPI2C=n
CONFIG_HAL_PERIPH_SRC_STM32F4XX_HAL_FMPI2C_EX=n
CONFIG_HAL_PERIPH_SRC_STM32F4XX_HAL_FMPSMBUS=n
CONFIG_HAL_PERIPH_SRC_STM32F4XX_HAL_FMPSMBUS_EX=n
CONFIG_HAL_PERIPH_SRC_STM32F4XX_HAL_HASH=n
CONFIG_HAL_PERIPH_SRC_STM32F4XX_HAL_HASH_EX=n
CONFIG_HAL_PERIPH_SRC_STM32F4XX_HAL_HCD=n
CONFIG_HAL_PERIPH_SRC_STM32F4XX_HAL_I2C=n
CONFIG_HAL_PERIPH_SRC_STM32F4XX_HAL_I2C_EX=n
CONFIG_HAL_PERIPH_SRC_STM32F4XX_HAL_I2S=n
CONFIG_HAL_PERIPH_SRC_STM32F4XX_HAL_I2S_EX=n
CONFIG_HAL_PERIPH_SRC_STM32F4XX_HAL_IRDA=n
CONFIG_HAL_PERIPH_SRC_STM32F4XX_HAL_IWDG=n
CONFIG_HAL_PERIPH_SRC_STM32F4XX_HAL_LPTIM=n
CONFIG_HAL_PERIPH_SRC_STM32F4XX_HAL_LTDC=n
CONFIG_HAL_PERIPH_SRC_STM32F4XX_HAL_LTDC_EX=n
CONFIG_HAL_PERIPH_SRC_STM32F4XX_HAL_MMC=n
CONFIG_HAL_PERIPH_SRC_STM32F4XX_HAL_NAND=n
CONFIG_HAL_PERIPH_SRC_STM32F4XX_HAL_NOR=n
CONFIG_HAL_PERIPH_SRC_STM32F4XX_HAL_PCCARD=n
CONFIG_HAL_PERIPH_SRC_STM32F4XX_HAL_PCD=n
CONFIG_HAL_PERIPH_SRC_STM32F4XX_HAL_PCD_EX=n
CONFIG_HAL_PERIPH_SRC_STM32F4XX_HAL_QSPI=n
CONFIG_HAL_PERIPH_SRC_STM32F4XX_HAL_RNG=n
CONFIG_HAL_PERIPH_SRC_STM32F4XX_HAL_RTC=n
CONFIG_HAL_PERIPH_SRC_STM32F4XX_HAL_RTC_EX=n
CONFIG_HAL_PERIPH_SRC_STM32F4XX_HAL_SAI=n
CONFIG_HAL_PERIPH_SRC_STM32F4XX_HAL_SAI_EX=n
CONFIG_HAL_PERIPH_SRC_STM32F4XX_HAL_SD=n
CONFIG_HAL_PERIPH_SRC_STM32F4XX_HAL_SDRAM=n
CONFIG_HAL_PERIPH_SRC_STM32F4XX_HAL_SMARTCARD=n
CONFIG_HAL_PERIPH_SRC_STM32F4XX_HAL_SMBUS=n
CONFIG_HAL_PERIPH_SRC_STM32F4XX_HAL_SPDIFRX=n
CONFIG_HAL_PERIPH_SRC_STM32F4XX_HAL_SPI=n
CONFIG_HAL_PERIPH_SRC_STM32F4XX_HAL_SRAM=n
CONFIG_HAL_PERIPH_SRC_STM32F4XX_HAL_TIM=n
CONFIG_HAL_PERIPH_SRC_STM32F4XX_HAL_TIM_EX=n
CONFIG_HAL_PERIPH_SRC_STM32F4XX_HAL_UART=n
CONFIG_HAL_PERIPH_SRC_STM32F4XX_HAL_USART=n
CONFIG_HAL_PERIPH_SRC_STM32F4XX_HAL_WWDG=n
# <<< USER_CUSTOM
```
