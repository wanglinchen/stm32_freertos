## Kconfig
```kconfig
# 自动生成，勿手改。刷新：python3 build/build.py update
mainmenu "stm32-freertos"

config APL
	bool "apl"
	default y
if APL
source "apl/Kconfig"
endif

config BSL
	bool "bsl"
	default y
if BSL
source "bsl/Kconfig"
endif

config FML
	bool "fml"
	default y
if FML
source "fml/Kconfig"
endif

config HAL
	bool "hal"
	default y
if HAL
source "hal/Kconfig"
endif

config OSL
	bool "osl"
	default y
if OSL
source "osl/Kconfig"
endif
```

## apl/Kconfig
```kconfig
# 自动生成，勿手改。刷新：python3 build/build.py update
menu "apl"

config APL_SRC
	bool "src"
	default y
if APL_SRC
source "apl/src/Kconfig"
endif

endmenu
```

## apl/src/Kconfig
```kconfig
# 自动生成，勿手改。刷新：python3 build/build.py update
menu "src"

config APL_SRC_MAIN
	bool "main.c"
	default y

endmenu
```

## bsl/Kconfig
```kconfig
# 自动生成，勿手改。刷新：python3 build/build.py update
menu "bsl"

config BSL_SRC
	bool "src"
	default y
if BSL_SRC
source "bsl/src/Kconfig"
endif

endmenu
```

## bsl/src/Kconfig
```kconfig
# 自动生成，勿手改。刷新：python3 build/build.py update
menu "src"

config BSL_SRC_BOARD_BEEP
	bool "board_beep.c"
	default y

config BSL_SRC_BOARD_DEBUG_UART
	bool "board_debug_uart.c"
	default y

config BSL_SRC_BOARD_KEY
	bool "board_key.c"
	default y

config BSL_SRC_BOARD_LED
	bool "board_led.c"
	default y

config BSL_SRC_BOARD_SYSTEM
	bool "board_system.c"
	default y

endmenu
```

## fml/Kconfig
```kconfig
# 自动生成，勿手改。刷新：python3 build/build.py update
menu "fml"

config FML_SRC
	bool "src"
	default y
if FML_SRC
source "fml/src/Kconfig"
endif

endmenu
```

## fml/src/Kconfig
```kconfig
# 自动生成，勿手改。刷新：python3 build/create-project.py update
menu "src"

config FML_SRC_FML_BUTTON
	bool "fml_button.c"
	default y

config FML_SRC_FML_LED
	bool "fml_led.c"
	default y

endmenu
```

## hal/Kconfig
```kconfig
# 自动生成，勿手改。刷新：python3 build/build.py update
menu "hal"

config HAL_ARCH
	bool "arch"
	default y
if HAL_ARCH
source "hal/arch/Kconfig"
endif

config HAL_CHIP
	bool "chip"
	default y
if HAL_CHIP
source "hal/chip/Kconfig"
endif

config HAL_PERIPH
	bool "periph"
	default y
if HAL_PERIPH
source "hal/periph/Kconfig"
endif

endmenu
```

## hal/arch/Kconfig
```kconfig
# 自动生成，勿手改。刷新：python3 build/build.py update
menu "arch"

comment "无子目录、无源文件"

endmenu
```

## hal/chip/Kconfig
```kconfig
# 自动生成，勿手改。刷新：python3 build/build.py update
menu "chip"

config HAL_CHIP_REGISTER
	bool "register"
	default y
if HAL_CHIP_REGISTER
source "hal/chip/register/Kconfig"
endif

config HAL_CHIP_STARTUP
	bool "startup"
	default y
if HAL_CHIP_STARTUP
source "hal/chip/startup/Kconfig"
endif

endmenu
```

## hal/chip/register/Kconfig
```kconfig
# 自动生成，勿手改。刷新：python3 build/create-project.py update
menu "register"

config HAL_CHIP_REGISTER_INC
	bool "inc"
	default y
if HAL_CHIP_REGISTER_INC
source "hal/chip/register/inc/Kconfig"
endif

endmenu
```

## hal/chip/startup/Kconfig
```kconfig
# 自动生成，勿手改。刷新：python3 build/build.py update
menu "startup"

config HAL_CHIP_STARTUP_SRC
	bool "src"
	default y
if HAL_CHIP_STARTUP_SRC
source "hal/chip/startup/src/Kconfig"
endif

endmenu
```

## hal/chip/startup/inc/Kconfig
```kconfig
# 自动生成，勿手改。刷新：python3 build/create-project.py update
menu "inc"

comment "无子目录、无源文件"

endmenu
```

## hal/chip/startup/src/Kconfig
```kconfig
# 自动生成，勿手改。刷新：python3 build/create-project.py update
menu "src"

config HAL_CHIP_STARTUP_SRC_STARTUP_STM32F429XX
	bool "startup_stm32f429xx.s"
	default y

config HAL_CHIP_STARTUP_SRC_SYSTEM_STM32F4XX
	bool "system_stm32f4xx.c"
	default y

endmenu
```

## hal/periph/Kconfig
```kconfig
# 自动生成，勿手改。刷新：python3 build/build.py update
menu "periph"

config HAL_PERIPH_SRC
	bool "src"
	default y
if HAL_PERIPH_SRC
source "hal/periph/src/Kconfig"
endif

endmenu
```

## hal/periph/src/Kconfig
```kconfig
# 自动生成，勿手改。刷新：python3 build/build.py update
menu "src"

config HAL_PERIPH_SRC_STM32F4XX_HAL
	bool "stm32f4xx_hal.c"
	default y

config HAL_PERIPH_SRC_STM32F4XX_HAL_ADC
	bool "stm32f4xx_hal_adc.c"
	default y

config HAL_PERIPH_SRC_STM32F4XX_HAL_ADC_EX
	bool "stm32f4xx_hal_adc_ex.c"
	default y

config HAL_PERIPH_SRC_STM32F4XX_HAL_CAN
	bool "stm32f4xx_hal_can.c"
	default y

config HAL_PERIPH_SRC_STM32F4XX_HAL_CEC
	bool "stm32f4xx_hal_cec.c"
	default y

config HAL_PERIPH_SRC_STM32F4XX_HAL_CORTEX
	bool "stm32f4xx_hal_cortex.c"
	default y

config HAL_PERIPH_SRC_STM32F4XX_HAL_CRC
	bool "stm32f4xx_hal_crc.c"
	default y

config HAL_PERIPH_SRC_STM32F4XX_HAL_CRYP
	bool "stm32f4xx_hal_cryp.c"
	default y

config HAL_PERIPH_SRC_STM32F4XX_HAL_CRYP_EX
	bool "stm32f4xx_hal_cryp_ex.c"
	default y

config HAL_PERIPH_SRC_STM32F4XX_HAL_DAC
	bool "stm32f4xx_hal_dac.c"
	default y

config HAL_PERIPH_SRC_STM32F4XX_HAL_DAC_EX
	bool "stm32f4xx_hal_dac_ex.c"
	default y

config HAL_PERIPH_SRC_STM32F4XX_HAL_DCMI
	bool "stm32f4xx_hal_dcmi.c"
	default y

config HAL_PERIPH_SRC_STM32F4XX_HAL_DCMI_EX
	bool "stm32f4xx_hal_dcmi_ex.c"
	default y

config HAL_PERIPH_SRC_STM32F4XX_HAL_DFSDM
	bool "stm32f4xx_hal_dfsdm.c"
	default y

config HAL_PERIPH_SRC_STM32F4XX_HAL_DMA
	bool "stm32f4xx_hal_dma.c"
	default y

config HAL_PERIPH_SRC_STM32F4XX_HAL_DMA2D
	bool "stm32f4xx_hal_dma2d.c"
	default y

config HAL_PERIPH_SRC_STM32F4XX_HAL_DMA_EX
	bool "stm32f4xx_hal_dma_ex.c"
	default y

config HAL_PERIPH_SRC_STM32F4XX_HAL_DSI
	bool "stm32f4xx_hal_dsi.c"
	default y

config HAL_PERIPH_SRC_STM32F4XX_HAL_ETH
	bool "stm32f4xx_hal_eth.c"
	default y

config HAL_PERIPH_SRC_STM32F4XX_HAL_EXTI
	bool "stm32f4xx_hal_exti.c"
	default y

config HAL_PERIPH_SRC_STM32F4XX_HAL_FLASH
	bool "stm32f4xx_hal_flash.c"
	default y

config HAL_PERIPH_SRC_STM32F4XX_HAL_FLASH_EX
	bool "stm32f4xx_hal_flash_ex.c"
	default y

config HAL_PERIPH_SRC_STM32F4XX_HAL_FLASH_RAMFUNC
	bool "stm32f4xx_hal_flash_ramfunc.c"
	default y

config HAL_PERIPH_SRC_STM32F4XX_HAL_FMPI2C
	bool "stm32f4xx_hal_fmpi2c.c"
	default y

config HAL_PERIPH_SRC_STM32F4XX_HAL_FMPI2C_EX
	bool "stm32f4xx_hal_fmpi2c_ex.c"
	default y

config HAL_PERIPH_SRC_STM32F4XX_HAL_FMPSMBUS
	bool "stm32f4xx_hal_fmpsmbus.c"
	default y

config HAL_PERIPH_SRC_STM32F4XX_HAL_FMPSMBUS_EX
	bool "stm32f4xx_hal_fmpsmbus_ex.c"
	default y

config HAL_PERIPH_SRC_STM32F4XX_HAL_GPIO
	bool "stm32f4xx_hal_gpio.c"
	default y

config HAL_PERIPH_SRC_STM32F4XX_HAL_HASH
	bool "stm32f4xx_hal_hash.c"
	default y

config HAL_PERIPH_SRC_STM32F4XX_HAL_HASH_EX
	bool "stm32f4xx_hal_hash_ex.c"
	default y

config HAL_PERIPH_SRC_STM32F4XX_HAL_HCD
	bool "stm32f4xx_hal_hcd.c"
	default y

config HAL_PERIPH_SRC_STM32F4XX_HAL_I2C
	bool "stm32f4xx_hal_i2c.c"
	default y

config HAL_PERIPH_SRC_STM32F4XX_HAL_I2C_EX
	bool "stm32f4xx_hal_i2c_ex.c"
	default y

config HAL_PERIPH_SRC_STM32F4XX_HAL_I2S
	bool "stm32f4xx_hal_i2s.c"
	default y

config HAL_PERIPH_SRC_STM32F4XX_HAL_I2S_EX
	bool "stm32f4xx_hal_i2s_ex.c"
	default y

config HAL_PERIPH_SRC_STM32F4XX_HAL_IRDA
	bool "stm32f4xx_hal_irda.c"
	default y

config HAL_PERIPH_SRC_STM32F4XX_HAL_IWDG
	bool "stm32f4xx_hal_iwdg.c"
	default y

config HAL_PERIPH_SRC_STM32F4XX_HAL_LPTIM
	bool "stm32f4xx_hal_lptim.c"
	default y

config HAL_PERIPH_SRC_STM32F4XX_HAL_LTDC
	bool "stm32f4xx_hal_ltdc.c"
	default y

config HAL_PERIPH_SRC_STM32F4XX_HAL_LTDC_EX
	bool "stm32f4xx_hal_ltdc_ex.c"
	default y

config HAL_PERIPH_SRC_STM32F4XX_HAL_MMC
	bool "stm32f4xx_hal_mmc.c"
	default y

config HAL_PERIPH_SRC_STM32F4XX_HAL_NAND
	bool "stm32f4xx_hal_nand.c"
	default y

config HAL_PERIPH_SRC_STM32F4XX_HAL_NOR
	bool "stm32f4xx_hal_nor.c"
	default y

config HAL_PERIPH_SRC_STM32F4XX_HAL_PCCARD
	bool "stm32f4xx_hal_pccard.c"
	default y

config HAL_PERIPH_SRC_STM32F4XX_HAL_PCD
	bool "stm32f4xx_hal_pcd.c"
	default y

config HAL_PERIPH_SRC_STM32F4XX_HAL_PCD_EX
	bool "stm32f4xx_hal_pcd_ex.c"
	default y

config HAL_PERIPH_SRC_STM32F4XX_HAL_PWR
	bool "stm32f4xx_hal_pwr.c"
	default y

config HAL_PERIPH_SRC_STM32F4XX_HAL_PWR_EX
	bool "stm32f4xx_hal_pwr_ex.c"
	default y

config HAL_PERIPH_SRC_STM32F4XX_HAL_QSPI
	bool "stm32f4xx_hal_qspi.c"
	default y

config HAL_PERIPH_SRC_STM32F4XX_HAL_RCC
	bool "stm32f4xx_hal_rcc.c"
	default y

config HAL_PERIPH_SRC_STM32F4XX_HAL_RCC_EX
	bool "stm32f4xx_hal_rcc_ex.c"
	default y

config HAL_PERIPH_SRC_STM32F4XX_HAL_RNG
	bool "stm32f4xx_hal_rng.c"
	default y

config HAL_PERIPH_SRC_STM32F4XX_HAL_RTC
	bool "stm32f4xx_hal_rtc.c"
	default y

config HAL_PERIPH_SRC_STM32F4XX_HAL_RTC_EX
	bool "stm32f4xx_hal_rtc_ex.c"
	default y

config HAL_PERIPH_SRC_STM32F4XX_HAL_SAI
	bool "stm32f4xx_hal_sai.c"
	default y

config HAL_PERIPH_SRC_STM32F4XX_HAL_SAI_EX
	bool "stm32f4xx_hal_sai_ex.c"
	default y

config HAL_PERIPH_SRC_STM32F4XX_HAL_SD
	bool "stm32f4xx_hal_sd.c"
	default y

config HAL_PERIPH_SRC_STM32F4XX_HAL_SDRAM
	bool "stm32f4xx_hal_sdram.c"
	default y

config HAL_PERIPH_SRC_STM32F4XX_HAL_SMARTCARD
	bool "stm32f4xx_hal_smartcard.c"
	default y

config HAL_PERIPH_SRC_STM32F4XX_HAL_SMBUS
	bool "stm32f4xx_hal_smbus.c"
	default y

config HAL_PERIPH_SRC_STM32F4XX_HAL_SPDIFRX
	bool "stm32f4xx_hal_spdifrx.c"
	default y

config HAL_PERIPH_SRC_STM32F4XX_HAL_SPI
	bool "stm32f4xx_hal_spi.c"
	default y

config HAL_PERIPH_SRC_STM32F4XX_HAL_SRAM
	bool "stm32f4xx_hal_sram.c"
	default y

config HAL_PERIPH_SRC_STM32F4XX_HAL_TIM
	bool "stm32f4xx_hal_tim.c"
	default y

config HAL_PERIPH_SRC_STM32F4XX_HAL_TIM_EX
	bool "stm32f4xx_hal_tim_ex.c"
	default y

config HAL_PERIPH_SRC_STM32F4XX_HAL_UART
	bool "stm32f4xx_hal_uart.c"
	default y

config HAL_PERIPH_SRC_STM32F4XX_HAL_USART
	bool "stm32f4xx_hal_usart.c"
	default y

config HAL_PERIPH_SRC_STM32F4XX_HAL_WWDG
	bool "stm32f4xx_hal_wwdg.c"
	default y

endmenu
```

## osl/Kconfig
```kconfig
# 自动生成，勿手改。刷新：python3 build/build.py update
menu "osl"

config OSL_INC
	bool "inc"
	default y
if OSL_INC
source "osl/inc/Kconfig"
endif

config OSL_SRC
	bool "src"
	default y
if OSL_SRC
source "osl/src/Kconfig"
endif

endmenu
```

## osl/inc/Kconfig
```kconfig
# 自动生成，勿手改。刷新：python3 build/create-project.py update
menu "inc"

config OSL_INC_FREERTOS
	bool "freertos"
	default y
if OSL_INC_FREERTOS
source "osl/inc/freertos/Kconfig"
endif

endmenu
```

## osl/inc/freertos/Kconfig
```kconfig
# 自动生成，勿手改。刷新：python3 build/create-project.py update
menu "freertos"

config OSL_INC_FREERTOS_PORTABLE
	bool "portable"
	default y
if OSL_INC_FREERTOS_PORTABLE
source "osl/inc/freertos/portable/Kconfig"
endif

endmenu
```

## osl/inc/freertos/portable/GCC/ARM_CM4F/Kconfig
```kconfig
# 自动生成，勿手改。刷新：python3 build/create-project.py update
menu "ARM_CM4F"

comment "无子目录、无源文件"

endmenu
```

## osl/inc/freertos/portable/Kconfig
```kconfig
# 自动生成，勿手改。刷新：python3 build/create-project.py update
menu "portable"

config OSL_INC_FREERTOS_PORTABLE_GCC
	bool "GCC"
	default y
if OSL_INC_FREERTOS_PORTABLE_GCC
source "osl/inc/freertos/portable/GCC/Kconfig"
endif

endmenu
```

## osl/src/Kconfig
```kconfig
# 自动生成，勿手改。刷新：python3 build/build.py update
menu "src"

config OSL_SRC_FREERTOS
	bool "freertos"
	default y
if OSL_SRC_FREERTOS
source "osl/src/freertos/Kconfig"
endif

endmenu
```

## osl/src/freertos/Kconfig
```kconfig
# 自动生成，勿手改。刷新：python3 build/build.py update
menu "freertos"

config OSL_SRC_FREERTOS_EVENT_GROUPS
	bool "event_groups.c"
	default y

config OSL_SRC_FREERTOS_HEAP_4
	bool "heap_4.c"
	default y

config OSL_SRC_FREERTOS_LIST
	bool "list.c"
	default y

config OSL_SRC_FREERTOS_PORT_M4
	bool "port_m4.c"
	default y

config OSL_SRC_FREERTOS_QUEUE
	bool "queue.c"
	default y

config OSL_SRC_FREERTOS_STREAM_BUFFER
	bool "stream_buffer.c"
	default y

config OSL_SRC_FREERTOS_TASKS
	bool "tasks.c"
	default y

config OSL_SRC_FREERTOS_TIMERS
	bool "timers.c"
	default y

endmenu
```

## osl/src/freertos/portable/GCC/ARM_CM4F/Kconfig
```kconfig
# 自动生成，勿手改。刷新：python3 build/create-project.py update
menu "ARM_CM4F"

config OSL_SRC_FREERTOS_PORTABLE_GCC_ARM_CM4F_PORT
	bool "port.c"
	default y

endmenu
```

## osl/src/freertos/portable/GCC/Kconfig
```kconfig
# 自动生成，勿手改。刷新：python3 build/create-project.py update
menu "GCC"

config OSL_SRC_FREERTOS_PORTABLE_GCC_ARM_CM4F
	bool "ARM_CM4F"
	default y
if OSL_SRC_FREERTOS_PORTABLE_GCC_ARM_CM4F
source "osl/src/freertos/portable/GCC/ARM_CM4F/Kconfig"
endif

endmenu
```
