## apl/src/Kconfig
```kconfig
# 自动生成，勿手改。刷新：python3 build/build.py update
menu "src"

config APL_SRC_APP
	bool "app.c"
	default y

config APL_SRC_APP_BEEP
	bool "app_beep.c"
	default y

config APL_SRC_APP_CALC
	bool "app_calc.c"
	default y

config APL_SRC_APP_CALENDAR
	bool "app_calendar.c"
	default y

config APL_SRC_APP_EBOOK
	bool "app_ebook.c"
	default y

config APL_SRC_APP_IMU
	bool "app_imu.c"
	default y

config APL_SRC_APP_KEY
	bool "app_key.c"
	default y

config APL_SRC_APP_LED
	bool "app_led.c"
	default y

config APL_SRC_APP_LEVEL
	bool "app_level.c"
	default y

config APL_SRC_APP_NOTEPAD
	bool "app_notepad.c"
	default y

config APL_SRC_APP_PAINT
	bool "app_paint.c"
	default y

config APL_SRC_APP_PICVIEWER
	bool "app_picviewer.c"
	default y

config APL_SRC_APP_QR
	bool "app_qr.c"
	default y

config APL_SRC_APP_SAMPLE
	bool "app_sample.c"
	default y

config APL_SRC_APP_SETTINGS
	bool "app_settings.c"
	default y

config APL_SRC_MAIN
	bool "main.c"
	default y

endmenu
```

## bsl/src/Kconfig
```kconfig
# 自动生成，勿手改。刷新：python3 build/build.py update
menu "src"

config BSL_SRC_BOARD_AP3216C
	bool "board_ap3216c.c"
	default y

config BSL_SRC_BOARD_BEEP
	bool "board_beep.c"
	default y

config BSL_SRC_BOARD_DEBUG_UART
	bool "board_debug_uart.c"
	default y

config BSL_SRC_BOARD_DTB
	bool "board_dtb.s"
	default y

config BSL_SRC_BOARD_EEPROM
	bool "board_eeprom.c"
	default y

config BSL_SRC_BOARD_KEY
	bool "board_key.c"
	default y

config BSL_SRC_BOARD_LCD
	bool "board_lcd.c"
	default y

config BSL_SRC_BOARD_LED
	bool "board_led.c"
	default y

config BSL_SRC_BOARD_MPU9250
	bool "board_mpu9250.c"
	default y

config BSL_SRC_BOARD_NOR
	bool "board_nor.c"
	default y

config BSL_SRC_BOARD_POST
	bool "board_post.c"
	default y

config BSL_SRC_BOARD_RT
	bool "board_rt.c"
	default y

config BSL_SRC_BOARD_SDRAM
	bool "board_sdram.c"
	default y

config BSL_SRC_BOARD_SYSTEM
	bool "board_system.c"
	default y

config BSL_SRC_BOARD_TOUCH
	bool "board_touch.c"
	default y

config BSL_SRC_BOARD_TPAD
	bool "board_tpad.c"
	default y

config BSL_SRC_BOARD_WM8978
	bool "board_wm8978.c"
	default y

config BSL_SRC_BSL_ADC
	bool "bsl_adc.c"
	default y

config BSL_SRC_BSL_CAN
	bool "bsl_can.c"
	default y

config BSL_SRC_BSL_CRC
	bool "bsl_crc.c"
	default y

config BSL_SRC_BSL_DEVICE
	bool "bsl_device.c"
	default y

config BSL_SRC_BSL_FB
	bool "bsl_fb.c"
	default y

config BSL_SRC_BSL_FDT
	bool "bsl_fdt.c"
	default y

config BSL_SRC_BSL_GPIO
	bool "bsl_gpio.c"
	default y

config BSL_SRC_BSL_I2C_GPIO
	bool "bsl_i2c_gpio.c"
	default y

config BSL_SRC_BSL_INIT
	bool "bsl_init.c"
	default y

config BSL_SRC_BSL_LOG
	bool "bsl_log.c"
	default y

config BSL_SRC_BSL_PCF8574
	bool "bsl_pcf8574.c"
	default y

config BSL_SRC_BSL_RNG
	bool "bsl_rng.c"
	default y

config BSL_SRC_BSL_RTC
	bool "bsl_rtc.c"
	default y

config BSL_SRC_BSL_SAI
	bool "bsl_sai.c"
	default y

config BSL_SRC_BSL_SPI
	bool "bsl_spi.c"
	default y

config BSL_SRC_BSL_UART
	bool "bsl_uart.c"
	default y

endmenu
```

## fml/src/Kconfig
```kconfig
# 自动生成，勿手改。刷新：python3 build/build.py update
menu "src"

config FML_SRC_FATFS
	bool "fatfs"
	default y
if FML_SRC_FATFS
source "fml/src/fatfs/Kconfig"
endif

endmenu
```

## fml/src/fatfs/Kconfig
```kconfig
# 自动生成，勿手改。刷新：python3 build/build.py update
menu "fatfs"

config FML_SRC_FATFS_FF
	bool "ff.c"
	default y

config FML_SRC_FATFS_FFUNICODE
	bool "ffunicode.c"
	default y

endmenu
```
